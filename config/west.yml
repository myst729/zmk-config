## config/west.yml
```yaml
manifest:
  remotes:
    - name: myst729
      url-base: https://github.com/myst729
  projects:
    - name: zmk
      remote: myst729
      revision: main
      import: app/west.yml
  self:
    path: config
```
